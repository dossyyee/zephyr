## CMakeLists.txt
```
# SPDX-License-Identifier: Apache-2.0

cmake_minimum_required(VERSION 3.20.0)
find_package(Zephyr REQUIRED HINTS $ENV{ZEPHYR_BASE})
project(uwb_initiator)

target_sources(app PRIVATE src/main.c)
```

## prj.conf
```kconfig
CONFIG_GPIO=y
CONFIG_LOG=y

CONFIG_FPU=y

CONFIG_BT=y

# turn on when using python script to calculate dstnce
CONFIG_LOG_MODE_IMMEDIATE=n
```

## boards/nrf5340dk_nrf5340_cpuap.overlay
```dts
&timer0 {
	status = "okay";
    // The timer base frequency is given by 16 MHz divided by the prescaler
    prescaler = < 0x0 >;
};
```

## boards/nrf5340dk_nrf5340_cpuapp.overlay
```dts
&timer0 {
	status = "okay";
    // The timer base frequency is given by 16 MHz divided by the prescaler
    prescaler = < 0x0 >;
};

&rtc {
    status = "okay";
};
```

## src/main.c
```c
/*
 * Copyright (c) 2016 Intel Corporation
 *
 * SPDX-License-Identifier: Apache-2.0
 */

#include <stdio.h>
#include <string.h>
#include <zephyr/kernel.h>
#include <zephyr/drivers/gpio.h>
#include <zephyr/logging/log.h>
// #include <zephyr/timing/timing.h>

#include <zephyr/drivers/ieee802154/deca_device_api.h>
#include <zephyr/drivers/ieee802154/deca_interface.h>
#include <zephyr/drivers/ieee802154/deca_types.h>
#include <zephyr/drivers/ieee802154/deca_version.h>

#include <zephyr/drivers/ieee802154/ieee802154_dw3xxx.h>


LOG_MODULE_REGISTER(app);

/* 1000 msec = 1 sec */
#define SLEEP_TIME_MS   1000

/* The devicetree node identifier for the "led0" alias. */
#define LED0_NODE DT_ALIAS(led0)

/*
 * A build error on this line means your board is unsupported.
 * See the sample documentation for information on how to fix this.
 */
static const struct gpio_dt_spec led = GPIO_DT_SPEC_GET(LED0_NODE, gpios);
static const struct device *uwb = DEVICE_DT_GET(DT_INST(0, qorvo_dw3xxx));

int main(void)
{
	printk("Entering Main\n");
	// timing_init();
	// timing_start();

	int ret;
	if (!gpio_is_ready_dt(&led)) {
		return 0;
	}	
	ret = gpio_pin_configure_dt(&led, GPIO_OUTPUT_ACTIVE);
	if (ret < 0) {
		return 0;
	}

	dw3xxx_configure_device(uwb, RANGING_INITIATOR, HRP_UWB_PHY_CHANNEL_9);

	dw_enable_irq(uwb);

	while (1) {
		ret = run_initiator(uwb);
		if (ret == 0) {
			gpio_pin_toggle_dt(&led);
		}
		k_msleep(200); /* arbitrary delay for testing. */
	}

	LOG_ERR("Device not run");
	return 0;
}
```
