## CMakeLists.txt
```
# SPDX-License-Identifier: Apache-2.0

cmake_minimum_required(VERSION 3.20.0)
find_package(Zephyr REQUIRED HINTS $ENV{ZEPHYR_BASE})
project(uwb_qorvo_responder)

target_sources(app PRIVATE src/main.c src/shared_functions.c src/config_options.c)
```

## prj.conf
```kconfig
CONFIG_GPIO=y
CONFIG_LOG=y

CONFIG_FPU=y
CONFIG_SYSTEM_WORKQUEUE_STACK_SIZE=4096
```

## src/main.c
```c
/*
 * Copyright (c) 2016 Intel Corporation
 *
 * SPDX-License-Identifier: Apache-2.0
 */

#include <stdio.h>
#include <string.h>
#include <zephyr/kernel.h>
#include <zephyr/drivers/gpio.h>
#include <zephyr/logging/log.h>

#include <zephyr/drivers/ieee802154/deca_device_api.h>
#include <zephyr/drivers/ieee802154/deca_interface.h>
#include <zephyr/drivers/ieee802154/deca_types.h>
#include <zephyr/drivers/ieee802154/deca_version.h>

#include <zephyr/drivers/ieee802154/ieee802154_dw3xxx.h>

#include "shared_defines.h"
#include "shared_functions.h"


LOG_MODULE_REGISTER(app);

/* 1000 msec = 1 sec */
#define SLEEP_TIME_MS   1000

#define DEVICE_ROLE_RESPONDER

/* The devicetree node identifier for the "led0" alias. */
#define LED0_NODE DT_ALIAS(led0)

/*
 * A build error on this line means your board is unsupported.
 * See the sample documentation for information on how to fix this.
 */
static const struct gpio_dt_spec led = GPIO_DT_SPEC_GET(LED0_NODE, gpios);
static const struct device *uwb = DEVICE_DT_GET(DT_INST(0, qorvo_dw3xxx));


/* Interface functions for qorvo API */
int readfromspi(uint16_t headerLength, uint8_t *headerBuffer, uint16_t readlength, uint8_t *readBuffer)
{
	return dw_spi_read(uwb, headerLength, headerBuffer, readlength, readBuffer);
}
int writetospi(uint16_t headerLength, const uint8_t *headerBuffer, uint16_t bodyLength, const uint8_t *bodyBuffer)
{
	return dw_spi_write(uwb, headerLength, headerBuffer, bodyLength, bodyBuffer);
}
int writetospiwithcrc(uint16_t headerLength, const uint8_t *headerBuffer, uint16_t bodyLength, const uint8_t *bodyBuffer, uint8_t crc8)
{
	return 0;
}
void setslowrate(void) 
{
	return;
}
void setfastrate(void) 
{
	return;
}
void wakeup_device_with_io(void)
{
	dw_wakeup(uwb);
}

decaIrqStatus_t decamutexon(void)
{
	const struct dw3xxx_config *cfg = uwb->config;
	if (cfg->irq_gpio.port) {
		gpio_pin_interrupt_configure_dt(&cfg->irq_gpio, GPIO_INT_DISABLE);
	}
	return 1;
}

void decamutexoff(decaIrqStatus_t s)
{
	ARG_UNUSED(s);
	const struct dw3xxx_config *cfg = uwb->config;
	if (cfg->irq_gpio.port) {
		gpio_pin_interrupt_configure_dt(&cfg->irq_gpio, GPIO_INT_EDGE_RISING);
	}
}

void deca_sleep(unsigned int time_ms) {
	k_msleep(time_ms);
}

void deca_usleep(unsigned long time_us) {

	if  (time_us <= UINT16_MAX) {
		k_busy_wait((uint32_t)time_us);
	}
	else {
		k_msleep((int32_t)(time_us >> 10));
	}
}

/* Qorvo variables */
static const struct dwt_spi_s dw3000_spi_fct = {
    .readfromspi = readfromspi,
    .writetospi = writetospi,
    .writetospiwithcrc = writetospiwithcrc,
    .setslowrate = setslowrate,
    .setfastrate = setfastrate,
};

const struct dwt_probe_s dw3000_probe_interf = 
{
    .dw = NULL,
    .spi = (void*)&dw3000_spi_fct,
    .wakeup_device_with_io = wakeup_device_with_io,
};

//!!!!!!!!!!!!!!!!!!!!!!!!!!!!!!!!!!!!!!!!!!!!!!!!!!!!!!!!!!!!!!!!!!!!!!!!!!!!!!!!!!!!!!!!!!!!!!!!!!!!!!!!!!!!!!!!

/* Example application name and version to display on LCD screen. */
#define APP_NAME "DSTWR RE STS-SDC v1.0"

/* Default communication configuration. We use STS with SDC DW mode. */
static dwt_config_t config = {
    5,               /* Channel number. */
    DWT_PLEN_64,     /* Preamble length. Used in TX only. */
    DWT_PAC8,        /* Preamble acquisition chunk size. Used in RX only. */
    9,               /* TX preamble code. Used in TX only. */
    9,               /* RX preamble code. Used in RX only. */
    1,               /* 0 to use standard 8 symbol SFD, 1 to use non-standard 8 symbol, 2 for non-standard 16 symbol SFD and 3 for 4z 8 symbol SDF type */
    DWT_BR_6M8,      /* Data rate. */
    DWT_PHRMODE_STD, /* PHY header mode. */
    DWT_PHRRATE_STD, /* PHY header rate. */
    (65 + 8 - 8),    /* SFD timeout (preamble length + 1 + SFD length - PAC size). Used in RX only. */
    DWT_STS_MODE_1 | DWT_STS_MODE_SDC, /* STS mode 1 with SDC see NOTE on SDC below*/
    DWT_STS_LEN_64,                    /* STS length see allowed values in Enum dwt_sts_lengths_e */
    DWT_PDOA_M0                        /* PDOA mode off */
};

/* have some delay after each range (e.g. so LDC can be updated (on ARM eval boards), needs to be slightly less than RNG_DELAY_MS in the initiator example*/
#define DELAY_MS 980

/* Default antenna delay values for 64 MHz PRF. See NOTE 1 below. */
#define TX_ANT_DLY 16385
#define RX_ANT_DLY 16385

/* Frames used in the ranging process. See NOTE 2 below. */
static uint8_t rx_poll_msg[] = { 0x41, 0x88, 0, 0xCA, 0xDE, 'W', 'A', 'V', 'E', 0x21 };
static uint8_t tx_resp_msg[] = { 0x41, 0x88, 0, 0xCA, 0xDE, 'V', 'E', 'W', 'A', 0x10, 0x02, 0, 0 };
static uint8_t rx_final_msg[] = { 0x41, 0x88, 0, 0xCA, 0xDE, 'W', 'A', 'V', 'E', 0x23, 0, 0, 0, 0, 0, 0, 0, 0, 0, 0, 0, 0 };
/* Length of the common part of the message (up to and including the function code, see NOTE 2 below). */
#define ALL_MSG_COMMON_LEN 10
/* Index to access some of the fields in the frames involved in the process. */
#define ALL_MSG_SN_IDX            2
#define FINAL_MSG_POLL_TX_TS_IDX  10
#define FINAL_MSG_RESP_RX_TS_IDX  14
#define FINAL_MSG_FINAL_TX_TS_IDX 18
/* Frame sequence number, incremented after each transmission. */
static uint8_t frame_seq_nb = 0;

/* Buffer to store received messages.
 * Its size is adjusted to longest frame that this example code is supposed to handle. */
#define RX_BUF_LEN 24
static uint8_t rx_buffer[RX_BUF_LEN];

/* Hold copy of status register state here for reference so that it can be examined at a debug breakpoint. */
static uint32_t status_reg = 0;

/* Delay between frames, in UWB microseconds. See NOTE 4 below. */
/* This is the delay from Frame RX timestamp to TX reply timestamp used for calculating/setting the DW3000's delayed TX function. This includes the
 * frame length of approximately 180 us with above configuration. */
#define POLL_RX_TO_RESP_TX_DLY_UUS 900
/* This is the delay from the end of the frame transmission to the enable of the receiver, as programmed for the DW3000's wait for response feature. */
#define RESP_TX_TO_FINAL_RX_DLY_UUS 670
/* Receive final timeout. See NOTE 5 below. */
#define FINAL_RX_TIMEOUT_UUS 300
/* Preamble timeout, in multiple of PAC size. See NOTE 6 below. */
#define PRE_TIMEOUT 5

/* Timestamps of frames transmission/reception. */
static uint64_t poll_rx_ts;
static uint64_t resp_tx_ts;
static uint64_t final_rx_ts;

/* Hold copies of computed time of flight and distance here for reference so that it can be examined at a debug breakpoint. */
static double tof;
static double distance;

/* Values for the PG_DELAY and TX_POWER registers reflect the bandwidth and power of the spectrum at the current
 * temperature. These values can be calibrated prior to taking reference measurements. See NOTE 2 below. */
extern dwt_txconfig_t txconfig_options;

/*! ------------------------------------------------------------------------------------------------------------------
 * @fn ds_twr_sts_sdc_responder()
 *
 * @brief Application entry point.
 *
 * @param  none
 *
 * @return none
 */
int main(void)
{
    int range_ok = 0;
    
    /* Display application name on LCD. */
    printk("DSTWR RE STS-SDC v1.0\n");

    /* Configure SPI rate, DW3000 supports up to 36 MHz */
    //port_set_dw_ic_spi_fastrate();

    /* Reset DW IC */
    dw_reset(uwb); /* Target specific drive of RSTn line into DW IC low for a period. */

    k_msleep(2); // Time needed for DW3000 to start up (transition from INIT_RC to IDLE_RC

    /* Probe for the correct device driver. */
    dwt_probe((struct dwt_probe_s *)&dw3000_probe_interf);

    while (!dwt_checkidlerc()) /* Need to make sure DW IC is in IDLE_RC before proceeding */ { };

    if (dwt_initialise(DWT_DW_INIT) == DWT_ERROR)
    {
        printk("INIT FAILED     \n");
        while (1) { };
    }

    /* Configure DW IC. See NOTE 15 below. */
    /* if the dwt_configure returns DWT_ERROR either the PLL or RX calibration has failed the host should reset the device */
    if (dwt_configure(&config))
    {
        printk((unsigned char *)"CONFIG FAILED     \n");
        while (1) { };
    }

    /* Configure the TX spectrum parameters (power, PG delay and PG count) */
    dwt_configuretxrf(&txconfig_options);

    /* Apply default antenna delay value. See NOTE 1 below. */
    dwt_setrxantennadelay(RX_ANT_DLY);
    dwt_settxantennadelay(TX_ANT_DLY);

    /* Next can enable TX/RX states output on GPIOs 5 and 6 to help debug, and also TX/RX LEDs
     * Note, in real low power applications the LEDs should not be used. */
    dwt_setlnapamode(DWT_LNA_ENABLE | DWT_PA_ENABLE);

    /* Loop forever responding to ranging requests. */
    while (1)
    {
        k_msleep(1);
        /* turn off preamble timeout as the responder does not know when the poll is coming. */
        dwt_setpreambledetecttimeout(0);
        /* Clear reception timeout to start next ranging process. */
        dwt_setrxtimeout(0);

        /* Activate reception immediately. */
        dwt_rxenable(DWT_START_RX_IMMEDIATE);

        /* Poll for reception of a frame or error/timeout. See NOTE 8 below. */
        waitforsysstatus(&status_reg, NULL, (DWT_INT_RXFCG_BIT_MASK | SYS_STATUS_ALL_RX_TO | SYS_STATUS_ALL_RX_ERR), 0);

        if (status_reg & DWT_INT_RXFCG_BIT_MASK)
        {
            uint16_t frame_len;
            int goodSts = 0;    /* Used for checking STS quality in received signal */
            int16_t stsQual;    /* This will contain STS quality index */
            uint16_t stsStatus; /* Used to check for good STS status (no errors). */

            /* Clear good RX frame event in the DW3000 status register. */
            dwt_writesysstatuslo(DWT_INT_RXFCG_BIT_MASK);

            // as STS mode is used, we only consider frames that are received with good STS quality
            if (((goodSts = dwt_readstsquality(&stsQual)) >= 0) && (dwt_readstsstatus(&stsStatus, 0) == DWT_SUCCESS)) // if STS is good this will be true >= 0
            {
                /* A frame has been received, read it into the local buffer. */
                frame_len = dwt_getframelength();
                if (frame_len <= RX_BUF_LEN)
                {
                    dwt_readrxdata(rx_buffer, frame_len, 0);
                }

                /* Check that the frame is a poll sent by "DS TWR initiator" example.
                 * As the sequence number field of the frame is not relevant, it is cleared to simplify the validation of the frame. */
                rx_buffer[ALL_MSG_SN_IDX] = 0;
                if (memcmp(rx_buffer, rx_poll_msg, ALL_MSG_COMMON_LEN) == 0)
                {
                    uint32_t resp_tx_time;
                    int ret;

                    /* Retrieve poll reception timestamp. */
                    poll_rx_ts = get_rx_timestamp_u64();

                    /* Set send time for response. See NOTE 9 below. */
                    resp_tx_time = (poll_rx_ts + (POLL_RX_TO_RESP_TX_DLY_UUS * UUS_TO_DWT_TIME)) >> 8;
                    dwt_setdelayedtrxtime(resp_tx_time);

                    /* Set expected delay and timeout for final message reception. See NOTE 4 and 5 below. */
                    dwt_setrxaftertxdelay(RESP_TX_TO_FINAL_RX_DLY_UUS);
                    dwt_setrxtimeout(FINAL_RX_TIMEOUT_UUS);

                    /* Write and send the response message. See NOTE 10 below.*/
                    tx_resp_msg[ALL_MSG_SN_IDX] = frame_seq_nb;
                    dwt_writetxdata(sizeof(tx_resp_msg), tx_resp_msg, 0);  /* Zero offset in TX buffer. */
                    dwt_writetxfctrl(sizeof(tx_resp_msg) + FCS_LEN, 0, 1); /* Zero offset in TX buffer, ranging. */
                    /* Set preamble timeout for expected final frame from the initiator. See NOTE 6 below. */
                    dwt_setpreambledetecttimeout(PRE_TIMEOUT);
                    ret = dwt_starttx(DWT_START_TX_DELAYED | DWT_RESPONSE_EXPECTED);

                    /* If dwt_starttx() returns an error, abandon this ranging exchange and proceed to the next one. See NOTE 11 below. */
                    if (ret == DWT_ERROR)
                    {
                        continue;
                    }

                    /* Poll for reception of expected "final" frame or error/timeout. See NOTE 8 below. */
                    waitforsysstatus(&status_reg, NULL, (DWT_INT_RXFCG_BIT_MASK | SYS_STATUS_ALL_RX_TO | SYS_STATUS_ALL_RX_ERR), 0);

                    /* Increment frame sequence number after transmission of the response message (modulo 256). */
                    frame_seq_nb++;

                    if (status_reg & DWT_INT_RXFCG_BIT_MASK)
                    {
                        /* Clear good RX frame event and TX frame sent in the DW3000 status register. */
                        dwt_writesysstatuslo(DWT_INT_RXFCG_BIT_MASK | DWT_INT_TXFRS_BIT_MASK);

                        // as STS mode is used, we only consider frames that are received with good STS quality
                        if (((goodSts = dwt_readstsquality(&stsQual)) >= 0)
                            && (dwt_readstsstatus(&stsStatus, 0) == DWT_SUCCESS)) // if STS is good this will be true >= 0
                        {
                            /* A frame has been received, read it into the local buffer. */
                            frame_len = dwt_getframelength();
                            if (frame_len <= RX_BUF_LEN)
                            {
                                dwt_readrxdata(rx_buffer, frame_len, 0);
                            }

                            /* Check that the frame is a final message sent by "DS TWR initiator" example.
                             * As the sequence number field of the frame is not used in this example, it can be zeroed to ease the validation of the frame. */
                            rx_buffer[ALL_MSG_SN_IDX] = 0;
                            if (memcmp(rx_buffer, rx_final_msg, ALL_MSG_COMMON_LEN) == 0)
                            {
                                uint32_t poll_tx_ts, resp_rx_ts, final_tx_ts;
                                uint32_t poll_rx_ts_32, resp_tx_ts_32, final_rx_ts_32;
                                double Ra, Rb, Da, Db;
                                int64_t tof_dtu;

                                /* Retrieve response transmission and final reception timestamps. */
                                resp_tx_ts = get_tx_timestamp_u64();
                                final_rx_ts = get_rx_timestamp_u64();

                                /* Get timestamps embedded in the final message. */
                                final_msg_get_ts(&rx_buffer[FINAL_MSG_POLL_TX_TS_IDX], &poll_tx_ts);
                                final_msg_get_ts(&rx_buffer[FINAL_MSG_RESP_RX_TS_IDX], &resp_rx_ts);
                                final_msg_get_ts(&rx_buffer[FINAL_MSG_FINAL_TX_TS_IDX], &final_tx_ts);

                                /* Compute time of flight. 32-bit subtractions give correct answers even if clock has wrapped. See NOTE 12 below. */
                                poll_rx_ts_32 = (uint32_t)poll_rx_ts;
                                resp_tx_ts_32 = (uint32_t)resp_tx_ts;
                                final_rx_ts_32 = (uint32_t)final_rx_ts;
                                Ra = (double)(resp_rx_ts - poll_tx_ts);
                                Rb = (double)(final_rx_ts_32 - resp_tx_ts_32);
                                Da = (double)(final_tx_ts - resp_rx_ts);
                                Db = (double)(resp_tx_ts_32 - poll_rx_ts_32);
                                tof_dtu = (int64_t)((Ra * Rb - Da * Db) / (Ra + Rb + Da + Db));

                                tof = tof_dtu * DWT_TIME_UNITS;
                                distance = tof * SPEED_OF_LIGHT;

                                range_ok = 1;

								printk("Distance: %f\n", distance);
                            }
                        } // if STS good on the Final message reception
                    }
                    else
                    {
                        /* Clear RX error/timeout events in the DW3000 status register. */
                        dwt_writesysstatuslo(SYS_STATUS_ALL_RX_TO | SYS_STATUS_ALL_RX_ERR);
                    }
                }
            } // if STS good on the Poll message reception
        }
        else
        {
            /* Clear RX error/timeout events in the DW3000 status register. */
            dwt_writesysstatuslo(SYS_STATUS_ALL_RX_TO | SYS_STATUS_ALL_RX_ERR);
        }

        /* add some delay before next ranging exchange */
        if (range_ok)
        {
            range_ok = 0;
            k_msleep(DELAY_MS);
        }
    }
}
```

## src/config_options.h
```c
/*! ----------------------------------------------------------------------------
 * @file    config_options.h
 * @brief   Configuration options are selected here.
 *
 * @attention
 *
 * Copyright 2019(c) Decawave Ltd, Dublin, Ireland.
 *
 * All rights reserved.
 *
 */

#include <zephyr/drivers/ieee802154/deca_device_api.h>

#ifndef EXAMPLES_CONFIG_OPTIONS_H_
#define EXAMPLES_CONFIG_OPTIONS_H_

/* Index values for errors in array */
#define CRC_ERR_IDX                0
#define RSE_ERR_IDX                1
#define PHE_ERR_IDX                2
#define SFDTO_ERR_IDX              3
#define PTO_ERR_IDX                4
#define RTO_ERR_IDX                5
#define SPICRC_ERR_IDX             6
#define TXTO_ERR_IDX               7
#define ARFE_ERR_IDX               8
#define TS_MISMATCH_ERR_IDX        9
#define BAD_FRAME_ERR_IDX          10
#define PREAMBLE_COUNT_ERR_IDX     11
#define CP_QUAL_ERR_IDX            12
#define STS_PREAMBLE_ERR           13
#define STS_PEAK_GROWTH_RATE_ERR   14
#define STS_ADC_COUNT_ERR          15
#define STS_SFD_COUNT_ERR          16
#define STS_LATE_FIRST_PATH_ERR    17
#define STS_LATE_COARSE_EST_ERR    18
#define STS_COARSE_EST_EMPTY_ERR   19
#define STS_HIGH_NOISE_THREASH_ERR 20
#define STS_NON_TRIANGLE_ERR       21
#define STS_LOG_REG_FAILED_ERR     22

/*
 * Number of ranges to attempt in test
 */
#define RANGE_COUNT 200

/* Compensation value for CPU
 * The time taken to receive the poll frame, check for errors,
 * calculate length, read content, get poll timestamp,
 * calculate response timestamp and send delayed response with timestamp will
 * be different for each device.
 * Adjusting this value lower and lower until dwt_starttx() starts returning
 * DWT_ERROR status allows the user to tweak their system to calculate the
 * shortest turn-around time for messages.
 */
#define CPU_PROCESSING_TIME 400

/*
 * SPI Rate Configuration Settings
 */
#define CONFIG_SPI_FAST_RATE
//#define CONFIG_SPI_SLOW_RATE

/*
 * Changing threshold to 5ns for DW3000 B0 red board devices.
 * ~10% of ranging attempts have a larger than usual difference between Ipatov and STS.
 * A larger threshold allows for better coverage with this coverage.
 * This should be fixed for DW3000 C0 devices.
 */
#define TS_MISMATCH_THRESHOLD 5 * 64 /* 64 = 1 ns --> 5 ns */

/*
 * Please note that a PRF of 16 MHz and a STS PRF of 64 MHz will not be supported for the DW3000.
 */

/* Configuration option 01.
 * Channel 5, PRF 64M, Preamble Length 64, PAC 8, Preamble code 9, Data Rate 850k, STS Length 64
 */
//#define CONFIG_OPTION_01

/* Configuration option 02.
 * Channel 9, PRF 64M, Preamble Length 64, PAC 8, Preamble code 9, Data Rate 850k, STS Length 64
 */
//#define CONFIG_OPTION_02

/* Configuration option 03.
 * Channel 5, PRF 64M, Preamble Length 128, PAC 8, Preamble code 9, Data Rate 850k, STS Length 64
 */
//#define CONFIG_OPTION_03

/* Configuration option 04.
 * Channel 9, PRF 64M, Preamble Length 128, PAC 8, Preamble code 9, Data Rate 850k, STS Length 64
 */
//#define CONFIG_OPTION_04

/* Configuration option 05.
 * Channel 5, PRF 64M, Preamble Length 512, PAC 8, Preamble code 9, Data Rate 850k, STS Length 64
 */
//#define CONFIG_OPTION_05

/* Configuration option 06.
 * Channel 9, PRF 64M, Preamble Length 512, PAC 8, Preamble code 9, Data Rate 850k, STS Length 64
 */
//#define CONFIG_OPTION_06

/* Configuration option 07.
 * Channel 5, PRF 64M, Preamble Length 1024, PAC 8, Preamble code 9, Data Rate 850k, STS Length 64
 */
//#define CONFIG_OPTION_07

/* Configuration option 08.
 * Channel 9, PRF 64M, Preamble Length 1024, PAC 8, Preamble code 9, Data Rate 850k, STS Length 64
 */
//#define CONFIG_OPTION_08

/* Configuration option 09.
 * Channel 5, PRF 64M, Preamble Length 64, PAC 8, Preamble code 10, Data Rate 850k, STS Length 64
 */
//#define CONFIG_OPTION_09

/* Configuration option 10.
 * Channel 9, PRF 64M, Preamble Length 64, PAC 8, Preamble code 10, Data Rate 850k, STS Length 64
 */
//#define CONFIG_OPTION_10

/* Configuration option 11.
 * Channel 5, PRF 64M, Preamble Length 128, PAC 8, Preamble code 10, Data Rate 850k, STS Length 64
 */
//#define CONFIG_OPTION_11

/* Configuration option 12.
 * Channel 9, PRF 64M, Preamble Length 128, PAC 8, Preamble code 10, Data Rate 850k, STS Length 64
 */
//#define CONFIG_OPTION_12

/* Configuration option 13.
 * Channel 5, PRF 64M, Preamble Length 512, PAC 8, Preamble code 10, Data Rate 850k, STS Length 64
 */
//#define CONFIG_OPTION_13

/* Configuration option 14.
 * Channel 9, PRF 64M, Preamble Length 512, PAC 8, Preamble code 10, Data Rate 850k, STS Length 64
 */
//#define CONFIG_OPTION_14

/* Configuration option 15.
 * Channel 5, PRF 64M, Preamble Length 1024, PAC 8, Preamble code 10, Data Rate 850k, STS Length 64
 */
//#define CONFIG_OPTION_15

/* Configuration option 16.
 * Channel 9, PRF 64M, Preamble Length 1024, PAC 8, Preamble code 10, Data Rate 850k, STS Length 64
 */
//#define CONFIG_OPTION_16

/* Configuration option 17.
 * Channel 5, PRF 64M, Preamble Length 64, PAC 8, Preamble code 9, Data Rate 6.8M, STS Length 64
 */
//#define CONFIG_OPTION_17

/* Configuration option 18.
 * Channel 9, PRF 64M, Preamble Length 64, PAC 8, Preamble code 9, Data Rate 6.8M, STS Length 64
 */
//#define CONFIG_OPTION_18

/* Configuration option 19.
 * Channel 5, PRF 64M, Preamble Length 128, PAC 8, Preamble code 9, Data Rate 6.8M, STS Length 64
 */
//#define CONFIG_OPTION_19

/* Configuration option 20.
 * Channel 9, PRF 64M, Preamble Length 128, PAC 8, Preamble code 9, Data Rate 6.8M, STS Length 64
 */
//#define CONFIG_OPTION_20

/* Configuration option 21.
 * Channel 5, PRF 64M, Preamble Length 512, PAC 8, Preamble code 9, Data Rate 850k, STS Length 64
 */
//#define CONFIG_OPTION_21

/* Configuration option 22.
 * Channel 9, PRF 64M, Preamble Length 512, PAC 8, Preamble code 9, Data Rate 6.8M, STS Length 64
 */
//#define CONFIG_OPTION_22

/* Configuration option 23.
 * Channel 5, PRF 64M, Preamble Length 1024, PAC 8, Preamble code 9, Data Rate 6.8M, STS Length 64
 */
//#define CONFIG_OPTION_23

/* Configuration option 24.
 * Channel 9, PRF 64M, Preamble Length 1024, PAC 8, Preamble code 9, Data Rate 6.8M, STS Length 64
 */
//#define CONFIG_OPTION_24

/* Configuration option 25.
 * Channel 5, PRF 64M, Preamble Length 64, PAC 8, Preamble code 10, Data Rate 6.8M, STS Length 64
 */
//#define CONFIG_OPTION_25

/* Configuration option 26.
 * Channel 9, PRF 64M, Preamble Length 64, PAC 8, Preamble code 10, Data Rate 6.8M, STS Length 64
 */
//#define CONFIG_OPTION_26

/* Configuration option 27.
 * Channel 5, PRF 64M, Preamble Length 128, PAC 8, Preamble code 10, Data Rate 6.8M, STS Length 64
 */
//#define CONFIG_OPTION_27

/* Configuration option 28.
 * Channel 9, PRF 64M, Preamble Length 128, PAC 8, Preamble code 10, Data Rate 6.8M, STS Length 64
 */
//#define CONFIG_OPTION_28

/* Configuration option 29.
 * Channel 5, PRF 64M, Preamble Length 512, PAC 8, Preamble code 10, Data Rate 6.8M, STS Length 64
 */
//#define CONFIG_OPTION_29

/* Configuration option 30.
 * Channel 9, PRF 64M, Preamble Length 512, PAC 8, Preamble code 10, Data Rate 6.8M, STS Length 64
 */
//#define CONFIG_OPTION_30

/* Configuration option 31.
 * Channel 5, PRF 64M, Preamble Length 1024, PAC 8, Preamble code 10, Data Rate 6.8M, STS Length 64
 */
//#define CONFIG_OPTION_31

/* Configuration option 32.
 * Channel 9, PRF 64M, Preamble Length 1024, PAC 8, Preamble code 10, Data Rate 6.8M, STS Length 64
 */
//#define CONFIG_OPTION_32

/* Configuration option 33.
 * Channel 5, PRF 64M, Preamble Length 128, PAC 8, Preamble code 9, Data Rate 6.8M, STS Length 128
 */
#define CONFIG_OPTION_33

extern char dist_str[16];

#endif /* EXAMPLES_CONFIG_OPTIONS_H_ */
```

## src/shared_functions.c
```c
/*! ----------------------------------------------------------------------------
 * @file    shared_functions.h
 * @brief   Global functions are found here
 *
 * @attention
 *
 * Copyright 2013 - 2021 (c) Decawave Ltd, Dublin, Ireland.
 *
 * All rights reserved.
 *
 */

#include <zephyr/kernel.h>
#include "config_options.h"
#include <zephyr/drivers/ieee802154/deca_device_api.h>
#include <zephyr/drivers/ieee802154/deca_types.h>
//#include <port.h>
#include "shared_defines.h"
#include "shared_functions.h"
#include <stdlib.h>

extern dwt_config_t config_options;

/*Reference look-up table to calculate TxPower boost depending on frame duration
 * Using two different tables as per logarithmic calculation:
 *   - 1000us to 200us range - index unit of 25us
 *   - 200us to 70us -- index unit of 10us
 * The table values are in steps 0f 0.1dB
 * This allow to have a maximum granularity of 0.5dB between two frame durations, which is
 * in the magnitude of the DW3XXX TxOutput setting.
 */

const uint8_t txpower_boost_per_frame_duration_1000_200_us[LUT_1000_200_US_NUM] = {
    0,  // 1000us
    1,  // 975us  -> 1*0.1dB boost between 975us and 1000us frames
    2,  // 950us  -> 2*0.1dB boost between 950us and 1000us frames
    3,  // 925us
    4,  // 900us
    5,  // 875us
    6,  // 850us
    7,  // 825us
    8,  // 800us
    9,  // 775us
    10, // 750us
    11, // 725us
    13, // 700us
    15, // 675us
    17, // 650us
    19, // 625us
    21, // 600us
    23, // 575us
    25, // 550us
    27, // 525us
    29, // 500us
    31, // 475us
    33, // 450us
    35, // 425us
    38, // 400us
    41, // 375us
    44, // 350us
    47, // 325us
    50, // 300us
    54, // 275us
    58, // 250us
    63, // 225us
    68  // 200us
};

const uint8_t txpower_boost_per_frame_duration_200_70_us[LUT_200_70_US_NUM] = {
    68,  // 200us  -> 68*0.1dB boost between 200us frame and 1000us frame.
    70,  // 190us  -> 70*0.1dB boost between 190us and 1000us frame
    72,  // 180us
    74,  // 170us
    77,  // 160us
    80,  // 150us
    83,  // 140us
    86,  // 130us
    89,  // 120us
    93,  // 110us
    97,  // 100us
    102, // 90us
    107, // 80us
    113  // 70us
};

/*! ------------------------------------------------------------------------------------------------------------------
 * @fn calculate_power_boost()
 *
 * @brief Calculation the allowed power boost for a frame_duration_us frame relatively to a 1ms frame.
 *
 * @param reg: uint16_t duration of frame..
 *
 * @return boost: the amount of boost in 0.1dB steps which is allowed when transmitting the frame_dur_us frame
 *                relatively to a 1ms frame. For example, if the frame duration is 500us, then relatively to 1ms,
 *                a 3dB boost is allowed, and the function will return 30.
 */
uint8_t calculate_power_boost(uint16_t frame_duration_us)
{

    const uint8_t *lut = NULL;
    uint16_t lut_i;
    uint16_t lut_num;
    uint16_t lut_min;
    uint16_t lut_step;
    uint16_t limit;

    // If the frame is longer than the reference duration, then no boost to apply
    if (frame_duration_us >= FRAME_DURATION_REF)
    {
        return LUT_1000_200_US_MIN_BST;
    }
    else if (frame_duration_us < LUT_200_70_US_MIN) // If frame shorter than 70us apply the maximum boost
    {
        return LUT_200_70_US_MAX_BST;
    }
    else if (frame_duration_us > LUT_1000_200_US_MIN) // Select LUT table for frame 1000us > duration > 200us
    {
        lut_num = LUT_1000_200_US_NUM;
        lut_min = LUT_1000_200_US_MIN;
        lut_step = LUT_1000_200_US_STEP;
        lut = txpower_boost_per_frame_duration_1000_200_us;
    }
    else // Select LUT table for frame 200us > duration > 70us
    {
        lut_num = LUT_200_70_US_NUM;
        lut_min = LUT_200_70_US_MIN;
        lut_step = LUT_200_70_US_STEP;
        lut = txpower_boost_per_frame_duration_200_70_us;
    }

    // Calculating the LUT index corresponding to the frame duration
    lut_i = (lut_num - (frame_duration_us - lut_min) / lut_step);
    limit = (lut_num - lut_i) * lut_step + lut_min;

    // Selecting the index that gives the closest LUT duration to the one passed as argument.
    if (abs(frame_duration_us - limit) > lut_step / 2)
    {
        lut_i--;
    }

    // Boost is stored in the LUT at the calculated index - 1.
    // -1 to account for index 0
    // lut_i cannot be == 0 or > lut_num here
    return lut[lut_i - 1];
}

/*! ------------------------------------------------------------------------------------------------------------------
 * @fn check_for_status_errors()
 *
 * @brief This function is used to get a value to increase the delay timer by dependent on the current TX preamble length set.
 *
 * @param reg: uint32_t value representing the current status register value.
 * @param errors: pointer to a uint32_t buffer that contains the sum of different errors logged during program operation.
 *
 * @return none
 */
void check_for_status_errors(uint32_t reg, uint32_t *errors)
{
    uint16_t stsStatus = 0;

    if (!(reg & DWT_INT_RXFCG_BIT_MASK))
    {
        errors[BAD_FRAME_ERR_IDX] += 1;
    }

    if (reg & DWT_INT_RXFSL_BIT_MASK)
    {
        errors[RSE_ERR_IDX] += 1;
    }

    if (reg & DWT_INT_RXPHE_BIT_MASK)
    {
        errors[PHE_ERR_IDX] += 1;
    }

    if (reg & DWT_INT_RXPTO_BIT_MASK)
    {
        errors[PTO_ERR_IDX] += 1;
    }

    if (reg & DWT_INT_ARFE_BIT_MASK)
    {
        errors[ARFE_ERR_IDX] += 1;
    }

    if ((reg & DWT_INT_RXFR_BIT_MASK) && !(reg & DWT_INT_RXFCG_BIT_MASK))
    {
        errors[CRC_ERR_IDX] += 1;
    }

    if ((reg & DWT_INT_RXFTO_BIT_MASK) || (reg & SYS_STATUS_ALL_RX_TO))
    {
        errors[RTO_ERR_IDX] += 1;
    }

    if (reg & DWT_INT_RXSTO_BIT_MASK)
    {
        errors[SFDTO_ERR_IDX] += 1;
    }

    if (reg & DWT_INT_CPERR_BIT_MASK)
    {
        // There is a general STS error
        errors[STS_PREAMBLE_ERR] += 1;

        // Get the status for a more detailed error reading of what went wrong with the STS
        dwt_readstsstatus(&stsStatus, 0);
        if (stsStatus & 0x100)
        {
            // Peak growth rate warning
            errors[STS_PEAK_GROWTH_RATE_ERR] += 1;
        }
        if (stsStatus & 0x080)
        {
            // ADC count warning
            errors[STS_ADC_COUNT_ERR] += 1;
        }
        if (stsStatus & 0x040)
        {
            // SFD count warning
            errors[STS_SFD_COUNT_ERR] += 1;
        }
        if (stsStatus & 0x020)
        {
            // Late first path estimation
            errors[STS_LATE_FIRST_PATH_ERR] += 1;
        }
        if (stsStatus & 0x010)
        {
            // Late coarse estimation
            errors[STS_LATE_COARSE_EST_ERR] += 1;
        }
        if (stsStatus & 0x008)
        {
            // Coarse estimation empty
            errors[STS_COARSE_EST_EMPTY_ERR] += 1;
        }
        if (stsStatus & 0x004)
        {
            // High noise threshold
            errors[STS_HIGH_NOISE_THREASH_ERR] += 1;
        }
        if (stsStatus & 0x002)
        {
            // Non-triangle
            errors[STS_NON_TRIANGLE_ERR] += 1;
        }
        if (stsStatus & 0x001)
        {
            // Logistic regression failed
            errors[STS_LOG_REG_FAILED_ERR] += 1;
        }
    }
}

/*! ------------------------------------------------------------------------------------------------------------------
 * @fn get_rx_delay_time_txpreamble()
 *
 * @brief This function is used to get a value to increase the delay timer by dependent on the current TX preamble length set.
 *
 * @param None
 *
 * @return delay_time - a uint32_t value indicating the required increase needed to delay the time by.
 */
uint32_t get_rx_delay_time_txpreamble(void)
{
    uint32_t delay_time = 0;
    /* Standard delay values for preamble lengths of 32, 64, 72 & 128 should be adequate.
     * Additional time delay will be needed for larger preamble lengths.
     * Delay required is dependent on the preamble length as it increases the frame length. */
    switch (config_options.txPreambLength)
    {
    case DWT_PLEN_256:
        delay_time += 128; /* 256 - 128 */
        break;
    case DWT_PLEN_512:
        delay_time += 384; /* 512 - 128 */
        break;
    case DWT_PLEN_1024:
        delay_time += 896; /* 1024 - 128 */
        break;
    case DWT_PLEN_1536:
        delay_time += 1408; /* 1536 - 128 */
        break;
    case DWT_PLEN_2048:
        delay_time += 1920; /* 2048 - 128 */
        break;
    case DWT_PLEN_4096:
        delay_time += 3968; /* 4096 - 128 */
        break;
    case DWT_PLEN_32:
    case DWT_PLEN_64:
    case DWT_PLEN_72:
    case DWT_PLEN_128:
    default:
        break;
    }

    return delay_time;
}
/*! ------------------------------------------------------------------------------------------------------------------
 * @fn get_rx_delay_time_data_rate()
 *
 * @brief This function is used to get a value to increase the delay timer by dependent on the current data rate set.
 *
 * @param None
 *
 * @return delay_time - a uint32_t value indicating the required increase needed to delay the time by.
 */
uint32_t get_rx_delay_time_data_rate(void)
{
    uint32_t delay_time = 0;
    /*
     * If data rate is set to 850k (slower rate),
     * increase the delay time
     */
    switch (config_options.dataRate)
    {
    case DWT_BR_850K:
        delay_time += 200;
        break;
    case DWT_BR_6M8:
    default:
        break;
    }

    return delay_time;
}

/*! ------------------------------------------------------------------------------------------------------------------
 * @fn set_delayed_rx_time()
 *
 * @brief This function is used to set the delayed RX time before running dwt_rxenable()
 *
 * @param delay - This is a defined delay value (usually POLL_TX_TO_RESP_RX_DLY_UUS)
 * @param config_options - pointer to dwt_config_t configuration structure that is in use at the time this function
 *                         is called.
 *
 * @return None
 */
void set_delayed_rx_time(uint32_t delay, dwt_config_t *config_options)
{
    uint32_t delay_time = delay;

    switch (config_options->txPreambLength)
    {
    case DWT_PLEN_32:
        delay_time -= 32;
        break;
    case DWT_PLEN_64:
        delay_time -= 64;
        break;
    case DWT_PLEN_72:
        delay_time -= 72;
        break;
    case DWT_PLEN_128:
        delay_time -= 128;
        break;
    case DWT_PLEN_256:
        delay_time -= 256;
        break;
    case DWT_PLEN_512:
        delay_time -= 512;
        break;
    case DWT_PLEN_1024:
        delay_time -= 1024;
        break;
    case DWT_PLEN_1536:
        delay_time -= 1536;
        break;
    case DWT_PLEN_2048:
    case DWT_PLEN_4096:
        delay_time -= 2048;
        break;
    default:
        break;
    }

    /* Length of the STS effects the size of the frame also.
     * This means the delay required is greater for larger STS lengths. */
    delay_time += ((1 << (config_options->stsLength + 2)) * 8);

    dwt_setdelayedtrxtime((uint32_t)((delay_time * UUS_TO_DWT_TIME) >> 8));
}

/*! ------------------------------------------------------------------------------------------------------------------
 * @fn set_resp_rx_timeout()
 *
 * @brief This function is used to set the RX timeout value
 *
 * @param delay - This is a defined delay value (usually RESP_RX_TIMEOUT_UUS)
 * @param config_options - pointer to dwt_config_t configuration structure that is in use at the time this function
 *                         is called.
 *
 * @return None
 */
void set_resp_rx_timeout(uint32_t delay, dwt_config_t *config_options)
{
    /*
     * The program will need to adjust the timeout value depending on the size of the frame
     * Different sized frames require different time delays.
     */
    uint32_t delay_time = delay + get_rx_delay_time_data_rate() + get_rx_delay_time_txpreamble() + 500;

    /* Length of the STS effects the size of the frame also.
     * This means the delay required is greater for larger STS lengths. */
    switch (config_options->stsLength)
    {
    case DWT_STS_LEN_256:
    case DWT_STS_LEN_512:
    case DWT_STS_LEN_1024:
    case DWT_STS_LEN_2048:
        delay_time += ((1 << (config_options->stsLength + 2)) * 8);
        break;
    case DWT_STS_LEN_32:
    case DWT_STS_LEN_64:
    case DWT_STS_LEN_128:
    default:
        break;
    }

    dwt_setrxtimeout(delay_time);
}

/*! ------------------------------------------------------------------------------------------------------------------
 * @fn resp_msg_get_ts()
 *
 * @brief Read a given timestamp value from the response message. In the timestamp fields of the response message, the
 *        least significant byte is at the lower address.
 *
 * @param  ts_field  pointer on the first byte of the timestamp field to get
 *         ts  timestamp value
 *
 * @return none
 */
void resp_msg_get_ts(uint8_t *ts_field, uint32_t *ts)
{
    int i;
    *ts = 0;
    for (i = 0; i < RESP_MSG_TS_LEN; i++)
    {
        *ts += (uint32_t)ts_field[i] << (i * 8);
    }
}

/*! ------------------------------------------------------------------------------------------------------------------
 * @fn get_tx_timestamp_u64()
 *
 * @brief Get the TX time-stamp in a 64-bit variable.
 *        /!\ This function assumes that length of time-stamps is 40 bits, for both TX and RX!
 *
 * @param  none
 *
 * @return  64-bit value of the read time-stamp.
 */
uint64_t get_tx_timestamp_u64(void)
{
    uint8_t ts_tab[5];
    uint64_t ts = 0;
    int8_t i;
    dwt_readtxtimestamp(ts_tab);
    for (i = 4; i >= 0; i--)
    {
        ts <<= 8;
        ts |= ts_tab[i];
    }
    return ts;
}

/*! ------------------------------------------------------------------------------------------------------------------
 * @fn get_rx_timestamp_u64()
 *
 * @brief Get the RX time-stamp in a 64-bit variable.
 *        /!\ This function assumes that length of time-stamps is 40 bits, for both TX and RX!
 *
 * @param  none
 *
 * @return  64-bit value of the read time-stamp.
 */
uint64_t get_rx_timestamp_u64(void)
{
    uint8_t ts_tab[5];
    uint64_t ts = 0;
    int8_t i;
    dwt_readrxtimestamp(ts_tab);
    for (i = 4; i >= 0; i--)
    {
        ts <<= 8;
        ts |= ts_tab[i];
    }
    return ts;
}

/*! ------------------------------------------------------------------------------------------------------------------
 * @fn final_msg_get_ts()
 *
 * @brief Read a given timestamp value from the final message. In the timestamp fields of the final message, the least
 *        significant byte is at the lower address.
 *
 * @param  ts_field  pointer on the first byte of the timestamp field to read
 *         ts  timestamp value
 *
 * @return none
 */
void final_msg_get_ts(const uint8_t *ts_field, uint32_t *ts)
{
    uint8_t i;
    *ts = 0;
    for (i = 0; i < FINAL_MSG_TS_LEN; i++)
    {
        *ts += ((uint32_t)ts_field[i] << (i * 8));
    }
}

/*! ------------------------------------------------------------------------------------------------------------------
 * @fn final_msg_set_ts()
 *
 * @brief Fill a given timestamp field in the final message with the given value. In the timestamp fields of the final
 *        message, the least significant byte is at the lower address.
 *
 * @param  ts_field  pointer on the first byte of the timestamp field to fill
 *         ts  timestamp value
 *
 * @return none
 */
void final_msg_set_ts(uint8_t *ts_field, uint64_t ts)
{
    uint8_t i;
    for (i = 0; i < FINAL_MSG_TS_LEN; i++)
    {
        ts_field[i] = (uint8_t)ts;
        ts >>= 8;
    }
}

/*! ------------------------------------------------------------------------------------------------------------------
 * @fn resp_msg_set_ts()
 *
 * @brief Fill a given timestamp field in the response message with the given value. In the timestamp fields of the
 *        response message, the least significant byte is at the lower address.
 *
 * @param  ts_field  pointer on the first byte of the timestamp field to fill
 *         ts  timestamp value
 *
 * @return none
 */
void resp_msg_set_ts(uint8_t *ts_field, const uint64_t ts)
{
    uint8_t i;
    for (i = 0; i < RESP_MSG_TS_LEN; i++)
    {
        ts_field[i] = (uint8_t)(ts >> (i * 8));
    }
}

/*! ------------------------------------------------------------------------------------------------------------------
 * @brief This function will continuously read the system status register until it matches the bits set in the mask
 *        input parameter. It will then exit the function.
 *        This is useful to use when waiting on particular events to occurs. For example, the user could wait for a
 *        good UWB frame to be received and/or no receive errors have occurred.
 *        The lower 32-bits of the system status register will be read in a while loop. Each iteration of the loop will check if a matching
 *        mask value for the higher 32-bits of the system status register is set. If the mask value is set in the higher 32-bits of the system
 *        status register, the function will return that value along with the last recorded value of the lower 32-bits of the system status
 *        register. Thus, the user should be aware that this function will not wait for high and low mask values to be set in both the low and high
 *        system status registers. Alternatively, the user can call this function to *only* check the higher or lower system status registers.
 *
 * input parameters
 * @param lo_result - A pointer to a uint32_t that will contain the final value of the system status register (lower 32 bits).
 *                    Pass in a NULL pointer to ignore returning this value.
 * @param hi_result - A pointer to a uint32_t that will contain the final value of the system status register (higher 32 bits).
 *                    Pass in a NULL pointer to ignore returning this value.
 * @param lo_mask - a uint32 mask value that is used to check for certain bits to be set in the system status register (lower 32 bits).
 *               Example values to use are as follows:
 *               DWT_INT_TXFRS_BIT_MASK - Wait for a TX frame to be sent.
 *               SYS_STATUS_RXFCG_BIT_MASK | SYS_STATUS_ALL_RX_ERR - Wait for frame to be received and no reception errors.
 *               SYS_STATUS_RXFCG_BIT_MASK | SYS_STATUS_ALL_RX_TO | SYS_STATUS_ALL_RX_ERR - Wait for frame to be received and no receive timeout errors
 *                                                                                          and no reception errors.
 *               SYS_STATUS_RXFR_BIT_MASK | SYS_STATUS_ALL_RX_TO | SYS_STATUS_ALL_ND_RX_ERR - Wait for packet to be received and no receive timeout errors
 *                                                                                            and no reception errors.
 *                                                                                            These flags are useful when polling for STS Mode 4 (no data)
 *                                                                                            packets.
 *               0 - The function will not wait for any bits in the system status register (lower 32 bits).
 * @param hi_mask - a uint32 mask value that is used to check for certain bits to be set in the system status register (higher 32 bits).
 *               Example values to use are as follows:
 *               SYS_STATUS_HI_CCA_FAIL_BIT_MASK - Check for CCA fail status.
 *               0 - The function will not wait for any bits in the system status register (lower 32 bits).
 *
 * return None
 */
void waitforsysstatus(uint32_t *lo_result, uint32_t *hi_result, uint32_t lo_mask, uint32_t hi_mask)
{
    uint32_t lo_result_tmp = 0;
    uint32_t hi_result_tmp = 0;

    // If a mask has been passed into the function for the system status register (lower 32-bits)
    if (lo_mask)
    {
        while (!((lo_result_tmp = dwt_readsysstatuslo()) & (lo_mask)))
        {
            // If a mask value is set for the system status register (higher 32-bits)
            if (hi_mask)
            {
                // If mask value for the system status register (higher 32-bits) is found
                if ((hi_result_tmp = dwt_readsysstatushi()) & hi_mask)
                {
                    break;
                }
            }
        }
        
    }
    // if only a mask value for the system status register (higher 32-bits) is set
    else if (hi_mask)
    {
        while (!((hi_result_tmp = dwt_readsysstatushi()) & (hi_mask))) { };
    }

    if (lo_result != NULL)
    {
        *lo_result = lo_result_tmp;
    }

    if (hi_result != NULL)
    {
        *hi_result = hi_result_tmp;
    }
}
```
