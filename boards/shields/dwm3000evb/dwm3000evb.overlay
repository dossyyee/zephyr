/* Copyright (c) 2023 Nordic Semiconductor ASA
 *
 * SPDX-License-Identifier: LicenseRef-Nordic-5-Clause
 */
 ///delete-node/ &ieee802154;
/ {
	chosen {
		zephyr,ieee802154     = &ieee802154;
	};

	// leds {
	// 	compatible = "gpio-leds";

	// 	// /delete-node/ &red_led;
	// 	dwm3000ewb_led3: led_4 {
	// 		gpios = <&gpio1 4 (GPIO_ACTIVE_HIGH | GPIO_OPEN_SOURCE)>;
	// 	};

	// 	dwm3000ewb_led2: led_5 {
	// 		gpios = <&gpio1 5 (GPIO_ACTIVE_HIGH | GPIO_OPEN_SOURCE)>;
	// 	};
	// };

	// aliases {
	// 	dwm3000ewb-led3 = &dwm3000ewb_led3;
	// 	dwm3000ewb-led2 = &dwm3000ewb_led2;
	// };
};



&arduino_spi {
	status = "okay";

	ieee802154: dw3xxx@0 {
		compatible = "qorvo,dw3xxx";
		status = "okay";
		reg = <0>;
		spi-max-frequency = <8000000>;

		irq-gpios = <&arduino_header 14 GPIO_ACTIVE_HIGH >;
		wakeup-gpios = <&arduino_header 15 GPIO_ACTIVE_HIGH >;
		reset-gpios = <&arduino_header 13 (GPIO_ACTIVE_LOW | GPIO_OPEN_DRAIN) >;
	};
};
