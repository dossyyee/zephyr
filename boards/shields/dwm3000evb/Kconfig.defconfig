## boards/shields/dwm3000evb/Kconfig.shield
```kconfig
#
# Copyright (c) 2023 Nordic Semiconductor ASA
#
# SPDX-License-Identifier: LicenseRef-Nordic-5-Clause
#

# config SHIELD_NRF7002EK
# 	def_bool $(shields_list_contains,nrf7002ek)

# if SHIELD_NRF7002EK && NETWORKING

# configdefault MODEM
# 	default y

# configdefault MODEM_CONTEXT
# 	default y

# configdefault WIFI
# 	default y

# configdefault WIFI_NRF700X
# 	default y

# endif # SHIELD_NRF7002EK && NETWORKING

config SHIELD_DWM3000EVB
	def_bool $(shields_list_contains,dwm3000evb)
	select NETWORKING
	select IEEE802154
```

## drivers/ieee802154/Kconfig.dw3xxx
```kconfig
menuconfig IEEE802154_DW3XXX
	bool "Qorvo DW3xxx Driver support"
	default y
	depends on DT_HAS_QORVO_DW3XXX_ENABLED
	select SPI

if IEEE802154_DW3XXX

config IEEE802154_DW3XXX_INIT_PRIO
	int "DW3XXX initialization priority"
	default 80
	help
	  Set the initialization priority number. Do not mess with it unless
	  you know what you are doing. Beware DW3XXX requires gpio and spi to
	  be ready first (and sometime gpio should be the very first as spi
	  might need it too). And of course it has to start before the net stack.

endif 
```

## dts/bindings/ieee802154/qorvo,dw3xxx.yaml
```yaml
#
#

description: Decawave DW3110 802.15.4 UWB transceiver

compatible: "qorvo,dw3xxx"

include: spi-device.yaml

properties:
  irq-gpios:
    type: phandle-array
    required: true
    description: Interrupt pin.

      The interrupt pin IRQ of DW3110 is by default active 
      high output. If connected directly the MCU pin should 
      be configured as active high.
  
  wakeup-gpios:
    type: phandle-array
    required: false
    description: Wakeup pin.

      Optional method of waking up DW3000 device from sleep.
      Alternatively, wakeup form SPI can be used.

  reset-gpios:
    type: phandle-array
    required: true
    description: RESET pin.

      The RESET pin of DW3110 is active low.
      If connected directly the MCU pin should be configured
      as active low. It performs 2 functions, In general it is
      output but can also be used to reset the digital part of
      the IC if it is driven low. It should not be driven high 
      externally.

  tx-ant-delay:
    type: int
    description: Transmitter antenna delay.

  rx-ant-delay:
    type: int
    description: Receiver antenna delay.
```
